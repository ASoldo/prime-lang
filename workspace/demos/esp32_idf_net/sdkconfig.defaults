## workspace/demos/esp32_idf_net/sdkconfig.defaults
```kconfig
CONFIG_ESPTOOLPY_FLASHSIZE_4MB=y
CONFIG_ESPTOOLPY_FLASHMODE_DIO=y
CONFIG_ESPTOOLPY_FLASHFREQ_40M=y
CONFIG_PARTITION_TABLE_SINGLE_APP=y
CONFIG_APP_REPRODUCIBLE_BUILD=y
CONFIG_ESP_NETIF_TCPIP_LWIP=y
CONFIG_LWIP_NETIF_LOOPBACK=y
CONFIG_ESP_MAIN_TASK_STACK_SIZE=12288
```
